## Kconfig
```kconfig
# SPDX-License-Identifier: GPL-2.0
#
# For a description of the syntax of this configuration file,
# see Documentation/kbuild/kconfig-language.txt.
#
mainmenu "Linux/$ARCH $KERNELVERSION Kernel Configuration"

config SRCARCH
	string
	option env="SRCARCH"

source "arch/$SRCARCH/Kconfig"

source "test/Kconfig"

menu "Rissu misc"
config RSU_BYPASS_VERMAGIC
	bool "Bypass module version magic"
	default n
	help
	 If this option enabled, it will bypass vermagic.

config RSU_BYPASS_SYMVERSION
	bool "Bypass module symversion check"
	default n
	help
	 If this option enabled, it will bypass symversion check.

endmenu
```
